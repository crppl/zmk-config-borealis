## config/boards/shields/Kconfig.defconfig
```kconfig
if SHIELD_BOREALIS_LEFT

config ZMK_KEYBOARD_NAME
    default "Borealis"

config ZMK_SPLIT_ROLE_CENTRAL
    default y

endif

if SHIELD_BOREALIS_LEFT|| SHIELD_BOREALIS_RIGHT

config ZMK_SPLIT
    default y

endif
```

## config/boards/shields/Kconfig.shield
```kconfig
config SHIELD_BOREALIS_LEFT
    def_bool $(shields_list_contains,borealis_left)

config SHIELD_BOREALIS_RIGHT
    def_bool $(shields_list_contains,borealis_right)
```
